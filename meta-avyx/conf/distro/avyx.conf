## meta-avyx/conf/layer.conf
```bitbake
BBPATH .= ":${LAYERDIR}"
BBFILES += "${LAYERDIR}/recipes-*/*/*.bb ${LAYERDIR}/recipes-*/*/*.bbappend"
BBFILE_COLLECTIONS += "avyx"
BBFILE_PATTERN_avyx = "^${LAYERDIR}/"
BBFILE_PRIORITY_avyx = "12"
LAYERVERSION_avyx = "1"
LAYERSERIES_COMPAT_avyx = "scarthgap"
LAYERDEPENDS_avyx = "core openembedded-layer meta-python networking-layer multimedia-layer gnome-layer filesystems-layer wayland"
AVYX_LAYERDIR = "${LAYERDIR}"
```
